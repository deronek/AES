## aes-main/components/md-driver/Kconfig
```kconfig
menu "InvenSense MotionDriver"

    choice INV_GYRO
        prompt "Gyroscope model"
        default INV_GYRO_MPU9250
        help
            Select gyroscope model that you use.
        config INV_GYRO_MPU6050
            bool
            prompt "MPU6050"
        config INV_GYRO_MPU9150
            bool
            prompt "MPU9150"
        config INV_GYRO_MPU6500
            bool
            prompt "MPU6500"
        config INV_GYRO_MPU9250
            bool
            prompt "MPU9250"
    endchoice

endmenu
```

## aes-main/sdkconfig.defaults
```kconfig
# -O2 (performance) / -Os (size) optimization
CONFIG_COMPILER_OPTIMIZATION_PERF=y
# CONFIG_COMPILER_OPTIMIZATION_SIZE=y

# CPU frequency
CONFIG_ESP_DEFAULT_CPU_FREQ_MHZ_240=y
CONFIG_ESP_DEFAULT_CPU_FREQ_MHZ=240

# Verbose log level
# CONFIG_LOG_DEFAULT_LEVEL_VERBOSE=y

# At panic, print stack trace and halt
CONFIG_ESP_SYSTEM_PANIC_PRINT_HALT=y

# BT config
CONFIG_BT_ENABLED=y
CONFIG_BTDM_CTRL_MODE_BLE_ONLY=y
CONFIG_BTDM_CTRL_MODE_BR_EDR_ONLY=n
CONFIG_BTDM_CTRL_MODE_BTDM=n
CONFIG_ESP32_ENABLE_STACK_BT=y
CONFIG_MEMMAP_BT=y

# 1 maximum connection
CONFIG_BTDM_CONTROLLER_BLE_MAX_CONN=1
CONFIG_BT_MULTI_CONNECTION_ENBALE=n

# FreeRTOS frequency
CONFIG_FREERTOS_HZ=1000
```
